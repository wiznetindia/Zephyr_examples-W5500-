## boards/nucleo_f411re.conf
```kconfig
CONFIG_TEST_RANDOM_GENERATOR=y
# Ethernet
CONFIG_SPI=y
CONFIG_ETH_W5500=y
CONFIG_ETH_W5500_TIMEOUT=1000
CONFIG_NET_L2_ETHERNET=y
CONFIG_NET_MGMT=y
CONFIG_NET_DHCPV4=y
CONFIG_NET_TCP=y
```
